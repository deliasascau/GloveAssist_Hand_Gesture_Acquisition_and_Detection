## west.yml
```yaml
manifest:
  version: "0.13"

  projects:
    - name: zephyr
      url: https://github.com/zephyrproject-rtos/zephyr
      revision: v3.7.0
      import: true

  self:
    path: app
```
